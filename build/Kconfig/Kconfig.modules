## build/Kconfig/Kconfig.modules
```kconfig
menu "nanopb (/Users/goya/zmk-config-zonkey/modules/lib/nanopb)"
osource "$(ZEPHYR_NANOPB_KCONFIG)"
config ZEPHYR_NANOPB_MODULE
	bool
	default y
endmenu
menu "zmk-module-ble-management (/Users/goya/zmk-config-zonkey/zmk-module-ble-management)"
osource "/Users/goya/zmk-config-zonkey/zmk-module-ble-management/Kconfig"
config ZEPHYR_ZMK_MODULE_BLE_MANAGEMENT_MODULE
	bool
	default y
endmenu
menu "zmk-module-battery-history (/Users/goya/zmk-config-zonkey/zmk-module-battery-history)"
osource "/Users/goya/zmk-config-zonkey/zmk-module-battery-history/Kconfig"
config ZEPHYR_ZMK_MODULE_BATTERY_HISTORY_MODULE
	bool
	default y
endmenu
menu "zmk-module-settings-rpc (/Users/goya/zmk-config-zonkey/zmk-module-settings-rpc)"
osource "/Users/goya/zmk-config-zonkey/zmk-module-settings-rpc/Kconfig"
config ZEPHYR_ZMK_MODULE_SETTINGS_RPC_MODULE
	bool
	default y
endmenu
menu "zmk-module-runtime-input-processor (/Users/goya/zmk-config-zonkey/zmk-module-runtime-input-processor)"
osource "/Users/goya/zmk-config-zonkey/zmk-module-runtime-input-processor/Kconfig"
config ZEPHYR_ZMK_MODULE_RUNTIME_INPUT_PROCESSOR_MODULE
	bool
	default y
endmenu
menu "zmk-behavior-runtime-sensor-rotate (/Users/goya/zmk-config-zonkey/zmk-behavior-runtime-sensor-rotate)"
osource "/Users/goya/zmk-config-zonkey/zmk-behavior-runtime-sensor-rotate/Kconfig"
config ZEPHYR_ZMK_BEHAVIOR_RUNTIME_SENSOR_ROTATE_MODULE
	bool
	default y
endmenu
menu "zmk-pmw3610-driver (/Users/goya/zmk-config-zonkey/zmk-pmw3610-driver)"
osource "/Users/goya/zmk-config-zonkey/zmk-pmw3610-driver/Kconfig"
config ZEPHYR_ZMK_PMW3610_DRIVER_MODULE
	bool
	default y
endmenu
menu "zmk-rgbled-widget (/Users/goya/zmk-config-zonkey/zmk-rgbled-widget)"
osource "/Users/goya/zmk-config-zonkey/zmk-rgbled-widget/Kconfig"
config ZEPHYR_ZMK_RGBLED_WIDGET_MODULE
	bool
	default y
endmenu
menu "acpica (/Users/goya/zmk-config-zonkey/modules/lib/acpica)"
osource "$(ZEPHYR_ACPICA_KCONFIG)"
config ZEPHYR_ACPICA_MODULE
	bool
	default y
endmenu
menu "canopennode (/Users/goya/zmk-config-zonkey/modules/lib/canopennode)"
osource "$(ZEPHYR_CANOPENNODE_KCONFIG)"
config ZEPHYR_CANOPENNODE_MODULE
	bool
	default y
endmenu
menu "cmsis (/Users/goya/zmk-config-zonkey/modules/hal/cmsis)"
osource "$(ZEPHYR_CMSIS_KCONFIG)"
config ZEPHYR_CMSIS_MODULE
	bool
	default y
endmenu
menu "cmsis-dsp (/Users/goya/zmk-config-zonkey/modules/lib/cmsis-dsp)"
osource "$(ZEPHYR_CMSIS_DSP_KCONFIG)"
config ZEPHYR_CMSIS_DSP_MODULE
	bool
	default y
endmenu
menu "cmsis-nn (/Users/goya/zmk-config-zonkey/modules/lib/cmsis-nn)"
osource "$(ZEPHYR_CMSIS_NN_KCONFIG)"
config ZEPHYR_CMSIS_NN_MODULE
	bool
	default y
endmenu
menu "fatfs (/Users/goya/zmk-config-zonkey/modules/fs/fatfs)"
osource "$(ZEPHYR_FATFS_KCONFIG)"
config ZEPHYR_FATFS_MODULE
	bool
	default y
endmenu
menu "hal_ambiq (/Users/goya/zmk-config-zonkey/modules/hal/ambiq)"
osource "$(ZEPHYR_HAL_AMBIQ_KCONFIG)"
config ZEPHYR_HAL_AMBIQ_MODULE
	bool
	default y
endmenu
menu "hal_espressif (/Users/goya/zmk-config-zonkey/modules/hal/espressif)"
osource "/Users/goya/zmk-config-zonkey/modules/hal/espressif/zephyr/Kconfig"
config ZEPHYR_HAL_ESPRESSIF_MODULE
	bool
	default y
endmenu
menu "hal_ethos_u (/Users/goya/zmk-config-zonkey/modules/hal/ethos_u)"
osource "$(ZEPHYR_HAL_ETHOS_U_KCONFIG)"
config ZEPHYR_HAL_ETHOS_U_MODULE
	bool
	default y
endmenu
menu "hal_gigadevice (/Users/goya/zmk-config-zonkey/modules/hal/gigadevice)"
osource "$(ZEPHYR_HAL_GIGADEVICE_KCONFIG)"
config ZEPHYR_HAL_GIGADEVICE_MODULE
	bool
	default y
endmenu
menu "hal_nordic (/Users/goya/zmk-config-zonkey/modules/hal/nordic)"
osource "$(ZEPHYR_HAL_NORDIC_KCONFIG)"
config ZEPHYR_HAL_NORDIC_MODULE
	bool
	default y
endmenu
menu "hal_rpi_pico (/Users/goya/zmk-config-zonkey/modules/hal/rpi_pico)"
osource "$(ZEPHYR_HAL_RPI_PICO_KCONFIG)"
config ZEPHYR_HAL_RPI_PICO_MODULE
	bool
	default y
endmenu
menu "hal_telink (/Users/goya/zmk-config-zonkey/modules/hal/telink)"
osource "/Users/goya/zmk-config-zonkey/modules/hal/telink/Kconfig"
config ZEPHYR_HAL_TELINK_MODULE
	bool
	default y
endmenu
menu "liblc3 (/Users/goya/zmk-config-zonkey/modules/lib/liblc3)"
osource "$(ZEPHYR_LIBLC3_KCONFIG)"
config ZEPHYR_LIBLC3_MODULE
	bool
	default y
endmenu
menu "littlefs (/Users/goya/zmk-config-zonkey/modules/fs/littlefs)"
osource "$(ZEPHYR_LITTLEFS_KCONFIG)"
config ZEPHYR_LITTLEFS_MODULE
	bool
	default y
endmenu
menu "lvgl (/Users/goya/zmk-config-zonkey/modules/lib/gui/lvgl)"
osource "/Users/goya/zmk-config-zonkey/modules/lib/gui/lvgl/Kconfig"
config ZEPHYR_LVGL_MODULE
	bool
	default y
endmenu
menu "mbedtls (/Users/goya/zmk-config-zonkey/modules/crypto/mbedtls)"
osource "$(ZEPHYR_MBEDTLS_KCONFIG)"
config ZEPHYR_MBEDTLS_MODULE
	bool
	default y
endmenu
menu "percepio (/Users/goya/zmk-config-zonkey/modules/debug/percepio)"
osource "/Users/goya/zmk-config-zonkey/modules/debug/percepio/zephyr/Kconfig"
config ZEPHYR_PERCEPIO_MODULE
	bool
	default y
endmenu
menu "picolibc (/Users/goya/zmk-config-zonkey/modules/lib/picolibc)"
osource "/Users/goya/zmk-config-zonkey/modules/lib/picolibc/zephyr/Kconfig"
config ZEPHYR_PICOLIBC_MODULE
	bool
	default y
endmenu
menu "segger (/Users/goya/zmk-config-zonkey/modules/debug/segger)"
osource "$(ZEPHYR_SEGGER_KCONFIG)"
config ZEPHYR_SEGGER_MODULE
	bool
	default y
endmenu
menu "trusted-firmware-a (/Users/goya/zmk-config-zonkey/modules/tee/tf-a/trusted-firmware-a)"
osource "$(ZEPHYR_TRUSTED_FIRMWARE_A_KCONFIG)"
config ZEPHYR_TRUSTED_FIRMWARE_A_MODULE
	bool
	default y
endmenu
menu "uoscore-uedhoc (/Users/goya/zmk-config-zonkey/modules/lib/uoscore-uedhoc)"
osource "$(ZEPHYR_UOSCORE_UEDHOC_KCONFIG)"
config ZEPHYR_UOSCORE_UEDHOC_MODULE
	bool
	default y
endmenu
menu "zcbor (/Users/goya/zmk-config-zonkey/modules/lib/zcbor)"
osource "$(ZEPHYR_ZCBOR_KCONFIG)"
config ZEPHYR_ZCBOR_MODULE
	bool
	default y
endmenu
menu "module (/Users/goya/zmk-config-zonkey/zmk/app/module)"
osource "/Users/goya/zmk-config-zonkey/zmk/app/module/Kconfig"
config ZEPHYR_MODULE_MODULE
	bool
	default y
endmenu
```

## build/Kconfig/Kconfig.shield.defconfig
```kconfig
osource "/Users/goya/zmk-config-zonkey/zmk-module-ble-management/boards/shields/*/Kconfig.defconfig"
osource "/Users/goya/zmk-config-zonkey/zmk-module-battery-history/boards/shields/*/Kconfig.defconfig"
osource "/Users/goya/zmk-config-zonkey/zmk-module-settings-rpc/boards/shields/*/Kconfig.defconfig"
osource "/Users/goya/zmk-config-zonkey/zmk-module-runtime-input-processor/boards/shields/*/Kconfig.defconfig"
osource "/Users/goya/zmk-config-zonkey/zmk-behavior-runtime-sensor-rotate/boards/shields/*/Kconfig.defconfig"
osource "/Users/goya/zmk-config-zonkey/zmk-rgbled-widget/boards/shields/*/Kconfig.defconfig"
osource "/Users/goya/zmk-config-zonkey/zmk/app/boards/shields/*/Kconfig.defconfig"
```

## config/boards/shields/zonkey/Kconfig.defconfig
```kconfig
if SHIELD_ZONKEY_R

config ZMK_KEYBOARD_NAME
    default "zonkey_R"

config ZMK_SPLIT
    default y

config ZMK_SPLIT_ROLE_CENTRAL
    default y

endif

if SHIELD_ZONKEY_L

config ZMK_KEYBOARD_NAME
    default "zonkey_L"

config ZMK_SPLIT
    default y

endif
```

## config/boards/shields/zonkey/Kconfig.shield
```kconfig
config SHIELD_ZONKEY_R
    def_bool $(shields_list_contains,zonkey_R)

config SHIELD_ZONKEY_L
    def_bool $(shields_list_contains,zonkey_L)
```

## config/west.yml
```yaml
manifest:
  remotes:
    - name: zmkfirmware
      url-base: https://github.com/zmkfirmware
    - name: sekigon-gonnoc
      url-base: https://github.com/sekigon-gonnoc
    - name: kureyakey
      url-base: https://github.com/kureyakey
    - name: badjeff
      url-base: https://github.com/badjeff
  projects:
    - name: zmk
      remote: zmkfirmware
      revision: main
      import: app/west.yml
    - name: zmk-feature-non-lipo-battery-management
      remote: sekigon-gonnoc
      revision: main
    - name: zmk-pmw3610-driver
      remote: badjeff
      revision: main
    - name: zmk-rgbled-widget
      remote: kureyakey
      revision: main
  self:
    path: config
```
